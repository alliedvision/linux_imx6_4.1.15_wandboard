## drivers/mxc/Kconfig
```kconfig
# drivers/mxc/Kconfig

if ARCH_MXC

menu "MXC support drivers"

config MXC_IPU
	bool "Image Processing Unit Driver"
	select MXC_IPU_V3
	help
	  If you plan to use the Image Processing unit, say
	  Y here. IPU is needed by Framebuffer and V4L2 drivers.

source "drivers/mxc/mlb/Kconfig"
source "drivers/mxc/ipu3/Kconfig"
source "drivers/mxc/sim/Kconfig"
source "drivers/mxc/mipi/Kconfig"
source "drivers/mxc/vpu/Kconfig"
source "drivers/mxc/hdmi-cec/Kconfig"


config MXC_GPU_VIV
	depends on SOC_IMX6Q
	tristate "MXC Vivante GPU support"
	---help---
	Say Y to get the GPU driver support.

choice
	depends on MXC_GPU_VIV
	bool "GPU Driver version"
	default MXC_GPU_VIV_4_1_15

	help
	Select the GPU driver version that matches your userland libraries

config MXC_GPU_VIV_4_1_15
	bool "v4.1.15"

config MXC_GPU_VIV_3_14_28
	bool "v3.14.28"

endchoice



endmenu

endif
```
